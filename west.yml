## west.yml
```yaml
# Copyright (C) 2025 Infineon Technologies
# SPDX-License-Identifier: Apache-2.0

manifest:
  projects:
    - name: zephyr-vscode
      url: https://github.com/hakanjansson/zephyr-vscode.git
      revision: refs/heads/2025_01
    - name: zephyr-helpers
      url: https://github.com/hakanjansson/zephyr-helpers.git
      revision: refs/heads/2025_01
      import: true
```
